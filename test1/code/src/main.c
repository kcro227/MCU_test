#include "reg51.h"
char Led_Mode[] = {0x3f, 0x06, 0x5b, 0x4f, 0x66, 0x6d, 0x7d, 0x07, 0x7f, 0x6f, 0x77, 0x7c, 0x58, 0x5e, 0x79, 0x71};

char Key_Buf[] = {0xee, 0xde, 0xbe, 0x7e, 0xed, 0xdd, 0xbd, 0x7d, 0xeb, 0xdb, 0xbb, 0xe7, 0x7b, 0xd7, 0xb7, 0x77};

char get_key()
{
    static char Key_scan[] = {0xef, 0xdf, 0xbf, 0x7f};
    char i = 0, j = 0;
    for (i = 0; i < 4; i++) {
        P2 = Key_scan[i];
        if ((P2 & 0x0f) != 0x0f) {
            for (j = 0; j < 16; j++) {
                if (Key_Buf[j] == P2) return j;
            }
        }
    }
    return (-1);
}

void main()
{
    char key = 0;
    P0       = 0x00;

    while (1) {
        key = get_key();
        if (key != (-1)) P0 = Led_Mode[key];
    }
}